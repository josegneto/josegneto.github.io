// 2-dimensional array of row pin numbers:
int Row[] = {2,7,A5,5,13,A4,12,A2};
// 2-dimensional array of column pin numbers:
int Column[] = {6,11,10,3,A3,4,8,9};

unsigned char A[8][8] =     {0,0,0,0,0,0,0,0, 0,0,1,1,1,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1,0};
unsigned char B[8][8] =     {0,0,0,0,0,0,0,0, 0,1,1,1,1,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0,0};
unsigned char C[8][8] =     {0,0,0,0,0,0,0,0, 0,0,1,1,1,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0,0};
unsigned char D[8][8] =     {0,0,0,0,0,0,0,0, 0,1,1,1,1,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0,0};
unsigned char E[8][8] =     {0,0,0,0,0,0,0,0, 0,1,1,1,1,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1,0};
unsigned char F[8][8] =     {0,0,0,0,0,0,0,0, 0,1,1,1,1,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0,0};
unsigned char G[8][8] =     {0,0,0,0,0,0,0,0, 0,0,1,1,1,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0,0};
unsigned char H[8][8] =     {0,0,0,0,0,0,0,0, 0,1,1,0,0,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1,0};
unsigned char I[8][8] =     {0,0,0,0,0,0,0,0, 0,0,1,1,1,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0,0};
unsigned char J[8][8] =     {0,0,0,0,0,0,0,0, 0,0,0,1,1,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0,0};
unsigned char K[8][8] =     {0,0,0,0,0,0,0,0, 0,1,1,0,0,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1,0};
unsigned char L[8][8] =     {0,0,0,0,0,0,0,0, 0,1,1,0,0,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1,0};
unsigned char M[8][8] =     {0,0,0,0,0,0,0,0, 0,1,1,0,0,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1,1};
unsigned char N[8][8] =     {0,0,0,0,0,0,0,0, 0,1,1,0,0,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1,1};
unsigned char O[8][8] =     {0,0,0,0,0,0,0,0, 0,0,1,1,1,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0,0};
unsigned char P[8][8] =     {0,0,0,0,0,0,0,0, 0,1,1,1,1,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0,0};
unsigned char Q[8][8] =     {0,0,0,0,0,0,0,0, 0,0,1,1,1,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1,0};
unsigned char R[8][8] =     {0,0,0,0,0,0,0,0, 0,1,1,1,1,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1,0};
unsigned char S[8][8] =     {0,0,0,0,0,0,0,0, 0,0,1,1,1,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0,0};
unsigned char T[8][8] =     {0,0,0,0,0,0,0,0, 0,1,1,1,1,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0,0};
unsigned char U[8][8] =     {0,0,0,0,0,0,0,0, 0,1,1,0,0,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1,0};
unsigned char V[8][8] =     {0,0,0,0,0,0,0,0, 0,1,1,0,0,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0,0};
unsigned char W[8][8] =     {0,0,0,0,0,0,0,0, 0,1,1,0,0,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1,1};
unsigned char X[8][8] =     {0,0,0,0,0,0,0,0, 0,1,1,0,0,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1,1};
unsigned char Y[8][8] =     {0,0,0,0,0,0,0,0, 0,1,1,0,0,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0,0};
unsigned char Z[8][8] =     {0,0,0,0,0,0,0,0, 0,1,1,1,1,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1,0};

/*
unsigned char um[8][8] =    {0,0,0,0,0,0,0,0, 0,0,0,1,1,0,0,0, 0,0,0,1,1,0,0,0, 0,0,1,1,1,0,0,0, 0,0,0,1,1,0,0,0, 0,0,0,1,1,0,0,0, 0,0,0,1,1,0,0,0, 0,1,1,1,1,1,1,0};
unsigned char dois[8][8] =  {0,0,0,0,0,0,0,0, 0,0,1,1,1,1,0,0, 0,1,1,0,0,1,1,0, 0,0,0,0,0,1,1,0, 0,0,0,0,1,1,0,0, 0,0,1,1,0,0,0,0, 0,1,1,0,0,0,0,0, 0,1,1,1,1,1,1,0};
unsigned char tres[8][8] =  {0,0,0,0,0,0,0,0, 0,0,1,1,1,1,0,0, 0,1,1,0,0,1,1,0, 0,0,0,0,0,1,1,0, 0,0,0,1,1,1,0,0, 0,0,0,0,0,1,1,0, 0,1,1,0,0,1,1,0, 0,0,1,1,1,1,0,0};
unsigned char quatro[8][8]= {0,0,0,0,0,0,0,0, 0,0,0,0,1,1,0,0, 0,0,0,1,1,1,0,0, 0,0,1,0,1,1,0,0, 0,1,0,0,1,1,0,0, 0,1,1,1,1,1,1,0, 0,0,0,0,1,1,0,0, 0,0,0,0,1,1,0,0};
unsigned char cinco[8][8] = {0,0,0,0,0,0,0,0, 0,1,1,1,1,1,1,0, 0,1,1,0,0,0,0,0, 0,1,1,1,1,1,0,0, 0,0,0,0,0,1,1,0, 0,0,0,0,0,1,1,0, 0,1,1,0,0,1,1,0, 0,0,1,1,1,1,0,0};
unsigned char seis[8][8] =  {0,0,0,0,0,0,0,0, 0,0,1,1,1,1,0,0, 0,1,1,0,0,1,1,0, 0,1,1,0,0,0,0,0, 0,1,1,1,1,1,0,0, 0,1,1,0,0,1,1,0, 0,1,1,0,0,1,1,0, 0,0,1,1,1,1,0,0};
unsigned char sete[8][8] =  {0,0,0,0,0,0,0,0, 0,1,1,1,1,1,1,0, 0,1,1,0,0,1,1,0, 0,0,0,0,1,1,0,0, 0,0,0,0,1,1,0,0, 0,0,0,1,1,0,0,0, 0,0,0,1,1,0,0,0, 0,0,0,1,1,0,0,0};
unsigned char oito[8][8] =  {0,0,0,0,0,0,0,0, 0,0,1,1,1,1,0,0, 0,1,1,0,0,1,1,0, 0,1,1,0,0,1,1,0, 0,0,1,1,1,1,0,0, 0,1,1,0,0,1,1,0, 0,1,1,0,0,1,1,0, 0,0,1,1,1,1,0,0};
unsigned char nove[8][8] =  {0,0,0,0,0,0,0,0, 0,0,1,1,1,1,0,0, 0,1,1,0,0,1,1,0, 0,1,1,0,0,1,1,0, 0,0,1,1,1,1,1,0, 0,0,0,0,0,1,1,0, 0,1,1,0,0,1,1,0, 0,0,1,1,1,1,0,0}; */

void setup()
{
    Serial.begin(9600);

    // iterate over the pins:
    for(int i = 0; i<8; i++)
        // initialize the output pins:
    {
        pinMode(Row[i],OUTPUT);
        pinMode(Column[i],OUTPUT);
    }
}

void loop()
{
    if (Serial.available() > 0)
    {
      switch((char)Serial.read())
        {
          case 'A': 
          case 'a':
            Display(A);  
            break;
                     
          case 'B':
          case 'b':
            Display(B);  
            break;
                       
          case 'C':
          case 'c':
            Display(C);  
            break;
            
          case 'D':
          case 'd':
            Display(D);  
            break; 
            
          case 'E':
          case 'e':
            Display(E);  
            break;
            
          case 'F':
          case 'f':
            Display(F);  
            break; 
          
          case 'G':
          case 'g':
            Display(G);  
            break;
            
          case 'H':
          case 'h':
            Display(H);  
            break; 
          
          case 'I':
          case 'i':
            Display(I);  
            break;
            
          case 'J':
          case 'j':
            Display(J);  
            break; 
            
          case 'K':
          case 'k':
            Display(K);  
            break;
          
          case 'L':
          case 'l':
            Display(L);  
            break;
            
          case 'M':
          case 'm':
            Display(M);  
            break; 
                        
          case 'N':
          case 'n':
            Display(N);  
            break;
                        
          case 'O':
          case 'o':
            Display(O);  
            break;
                  
          case 'P':
          case 'p':
            Display(P);  
            break;
                        
          case 'Q':
          case 'q':
            Display(Q);  
            break;
                
          case 'R':
          case 'r':
            Display(R);  
            break;
            
          case 'S':
          case 's':
            Display(S);  
            break; 
            
          case 'T':
          case 't':
            Display(T);  
            break;
            
          case 'U':
          case 'u':
            Display(U);  
            break; 
          
          case 'V':
          case 'v':
            Display(V);  
            break;
            
          case 'W':
          case 'w':
            Display(W);  
            break; 
          
          case 'X':
          case 'x':
            Display(X);  
            break;
            
          case 'Y':
          case 'y':
            Display(Y);  
            break; 
            
          case 'Z':
          case 'z':
            Display(Z);  
            break;   

         /* case '0':
            Display(zero);  
            break;
            
          case '1':
            Display(um);  
            break;
          
          case '2':
            Display(dois);  
            break;
          
          case '3':
            Display(tres);  
            break;
          
          case '4':
            Display(quatro);  
            break;
          
          case '5':
            Display(cinco);  
            break;
          
          case '6':
            Display(seis);  
            break; 
          
          case '7':
            Display(7);  
            break;
          
          case '8':
            Display(oito);  
            break;
          
          case '9':
            Display(nove);  
            break;    */                 
    }
  }
}
void Display(unsigned char dat[8][8])
{
  for(int i = 0; i<100; i++)
  {
    for(int c = 0; c<8; c++)
    {
        digitalWrite(Column[c],LOW);//use thr column
        //loop
        for(int r = 0; r<8; r++)
        {
            digitalWrite(Row[r],dat[r][c]);
        }
        delay(1);
        Clear();  //Remove empty display light
    }
  }
}

void Clear()                               
{
    for(int i = 0; i<8; i++)
    {
        digitalWrite(Row[i],LOW);
        digitalWrite(Column[i],HIGH);
    }
}
