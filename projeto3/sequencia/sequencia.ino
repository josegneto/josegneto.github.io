/* Exibir sequencia por josegneto.github.io */

// Vetor com os pinos relativos as linhas
int Row[] = {2,7,A5,5,13,A4,12,A2};
// Vetor com os pinos relativos as colunas
int Column[] = {6,11,10,3,A3,4,8,9};

// Codigo que forma um circulo no centro do ecra

unsigned char ponto[8][8] = {0,0,0,0,0,0,0,0, 0,0,0,1,1,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0,0};

// Codigo de cada uma das letras do alfabeto

unsigned char A[8][8] =     {0,0,0,0,0,0,0,0, 0,0,1,1,1,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1,0};
unsigned char B[8][8] =     {0,0,0,0,0,0,0,0, 0,1,1,1,1,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0,0};
unsigned char C[8][8] =     {0,0,0,0,0,0,0,0, 0,0,1,1,1,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0,0};
unsigned char D[8][8] =     {0,0,0,0,0,0,0,0, 0,1,1,1,1,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0,0};
unsigned char E[8][8] =     {0,0,0,0,0,0,0,0, 0,1,1,1,1,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1,0};
unsigned char F[8][8] =     {0,0,0,0,0,0,0,0, 0,1,1,1,1,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0,0};
unsigned char G[8][8] =     {0,0,0,0,0,0,0,0, 0,0,1,1,1,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0,0};
unsigned char H[8][8] =     {0,0,0,0,0,0,0,0, 0,1,1,0,0,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1,0};
unsigned char I[8][8] =     {0,0,0,0,0,0,0,0, 0,0,1,1,1,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0,0};
unsigned char J[8][8] =     {0,0,0,0,0,0,0,0, 0,0,0,1,1,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0,0};
unsigned char K[8][8] =     {0,0,0,0,0,0,0,0, 0,1,1,0,0,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1,0};
unsigned char L[8][8] =     {0,0,0,0,0,0,0,0, 0,1,1,0,0,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1,0};
unsigned char M[8][8] =     {0,0,0,0,0,0,0,0, 0,1,1,0,0,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1,1};
unsigned char N[8][8] =     {0,0,0,0,0,0,0,0, 0,1,1,0,0,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1,1};
unsigned char O[8][8] =     {0,0,0,0,0,0,0,0, 0,0,1,1,1,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0,0};
unsigned char P[8][8] =     {0,0,0,0,0,0,0,0, 0,1,1,1,1,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0,0};
unsigned char Q[8][8] =     {0,0,0,0,0,0,0,0, 0,0,1,1,1,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1,0};
unsigned char R[8][8] =     {0,0,0,0,0,0,0,0, 0,1,1,1,1,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1,0};
unsigned char S[8][8] =     {0,0,0,0,0,0,0,0, 0,0,1,1,1,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0,0};
unsigned char T[8][8] =     {0,0,0,0,0,0,0,0, 0,1,1,1,1,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0,0};
unsigned char U[8][8] =     {0,0,0,0,0,0,0,0, 0,1,1,0,0,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1,0};
unsigned char V[8][8] =     {0,0,0,0,0,0,0,0, 0,1,1,0,0,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0,0};
unsigned char W[8][8] =     {0,0,0,0,0,0,0,0, 0,1,1,0,0,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1,1};
unsigned char X[8][8] =     {0,0,0,0,0,0,0,0, 0,1,1,0,0,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1,1};
unsigned char Y[8][8] =     {0,0,0,0,0,0,0,0, 0,1,1,0,0,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0,0};
unsigned char Z[8][8] =     {0,0,0,0,0,0,0,0, 0,1,1,1,1,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1,0};

// Codigo de cada um dos algarismos

unsigned char um[8][8] =    {0,0,0,0,0,0,0,0, 0,0,0,1,1,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1,0};
unsigned char dois[8][8] =  {0,0,0,0,0,0,0,0, 0,0,1,1,1,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1,0};
unsigned char tres[8][8] =  {0,0,0,0,0,0,0,0, 0,0,1,1,1,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0,0};
unsigned char quatro[8][8]= {0,0,0,0,0,0,0,0, 0,0,0,0,1,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0,0};
unsigned char cinco[8][8] = {0,0,0,0,0,0,0,0, 0,1,1,1,1,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0,0};
unsigned char seis[8][8] =  {0,0,0,0,0,0,0,0, 0,0,1,1,1,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0,0};
unsigned char sete[8][8] =  {0,0,0,0,0,0,0,0, 0,1,1,1,1,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0,0};
unsigned char oito[8][8] =  {0,0,0,0,0,0,0,0, 0,0,1,1,1,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0,0};
unsigned char nove[8][8] =  {0,0,0,0,0,0,0,0, 0,0,1,1,1,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0,0}; 
unsigned char zero[8][8] =  {0,0,0,0,0,0,0,0, 0,0,1,1,1,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0,0}; 

void setup()
{
    // Percorre todos os pinos
    for(int i = 0; i<8; i++)
    // Inicializa os pinos como outputs
    {
        pinMode(Row[i],OUTPUT);
        pinMode(Column[i],OUTPUT);
    }
}

void loop()
{
    //Exibe "JOSE NETO . 2018 ."

    Display(J);    
    Display(O);
    Display(S);    
    Display(E);
    Display(N);    
    Display(E);
    Display(T);    
    Display(O);
    Display(ponto);    
    Display(dois);
    Display(zero);    
    Display(um);
    Display(oito); 
    Display(ponto);    
   
    delay(1000);
}

void Display(unsigned char dat[8][8])
{
  for(int i = 0; i<150; i++)
  {
    for(int c = 0; c<8; c++)
    {
        digitalWrite(Column[c],LOW); 
        
        for(int r = 0; r<8; r++)
        {
            digitalWrite(Row[r],dat[r][c]);
        }
        delay(1);
        Clear();  
    }
  }
}

void Clear()                               
{
    for(int i = 0; i<8; i++)
    {
        digitalWrite(Row[i],LOW);
        digitalWrite(Column[i],HIGH);
    }
}